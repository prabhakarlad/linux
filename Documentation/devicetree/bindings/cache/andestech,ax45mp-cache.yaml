## Documentation/devicetree/bindings/cache/andestech,ax45mp-cache.yaml
```yaml
# SPDX-License-Identifier: (GPL-2.0 OR BSD-2-Clause)
# Copyright (C) 2022 Renesas Electronics Corp.
%YAML 1.2
---
$id: http://devicetree.org/schemas/cache/andestech,ax45mp-cache.yaml#
$schema: http://devicetree.org/meta-schemas/core.yaml#

title: Andestech AX45MP L2 Cache Controller

maintainers:
  - Lad Prabhakar <prabhakar.mahadev-lad.rj@bp.renesas.com>

description:
  A level-2 cache (L2C) is used to improve the system performance by providing
  a larger amount of cache line entries and reasonable access delays. The L2C
  is shared between cores, and a non-inclusive non-exclusive policy is used.

select:
  properties:
    compatible:
      contains:
        enum:
          - andestech,ax45mp-cache

  required:
    - compatible

properties:
  compatible:
    items:
      - const: andestech,ax45mp-cache
      - const: cache

  reg:
    maxItems: 1

  interrupts:
    maxItems: 1

  cache-line-size:
    const: 64

  cache-level:
    const: 2

  cache-sets:
    const: 1024

  cache-size:
    enum: [131072, 262144, 524288, 1048576, 2097152]

  cache-unified: true

  next-level-cache: true

  andestech,pma-regions:
    $ref: /schemas/types.yaml#/definitions/uint32-matrix
    minItems: 1
    maxItems: 16
    description: Optional array of memory regions to be set as non-cacheable
                 bufferable regions which will be setup in the PMA.

  andestech,inst-prefetch:
    description: Instruction prefetch depth
    $ref: /schemas/types.yaml#/definitions/uint32
    enum: [ 0, 1, 2, 3 ]

  andestech,data-prefetch:
    description: Data prefetch depth
    $ref: /schemas/types.yaml#/definitions/uint32
    enum: [ 0, 1, 2, 3 ]

  andestech,tag-ram-ctl:
    description: Tag RAM output cycle. First tuple indicates output cycle and the
      second tuple indicates setup cycle.
    $ref: /schemas/types.yaml#/definitions/uint8-array
    items:
      - minimum: 0
        maximum: 2
      - minimum: 0
        maximum: 2

  andestech,data-ram-ctl:
    description: Data RAM output cycle. First tuple indicates output cycle and the
      second tuple indicates setup cycle.
    $ref: /schemas/types.yaml#/definitions/uint8-array
    items:
      - minimum: 0
        maximum: 2
      - minimum: 0
        maximum: 2

additionalProperties: false

required:
  - compatible
  - cache-line-size
  - cache-level
  - cache-sets
  - cache-size
  - cache-unified
  - interrupts
  - reg

examples:
  - |
    #include <dt-bindings/interrupt-controller/irq.h>
    #include <dt-bindings/cache/andestech,ax45mp-cache.h>

    cache-controller@2010000 {
        reg = <0x13400000 0x100000>;
        compatible = "andestech,ax45mp-cache", "cache";
        interrupts = <508 IRQ_TYPE_LEVEL_HIGH>;
        cache-line-size = <64>;
        cache-level = <2>;
        cache-sets = <1024>;
        cache-size = <262144>;
        cache-unified;
        andestech,pma-regions = <0x58000000 0x08000000
                                 (AX45MP_PMACFG_ETYP_NAPOT | AX45MP_PMACFG_MTYP_MEM_NON_CACHE_BUF)>;
        andestech,inst-prefetch = <0x3>;
        andestech,data-prefetch = <0x3>;
        andestech,tag-ram-ctl = /bits/ 8 <0x1 0x0>;
        andestech,data-ram-ctl = /bits/ 8 <0x1 0x0>;
    };
```

## drivers/cache/Kconfig
```kconfig
# SPDX-License-Identifier: GPL-2.0

menuconfig CACHE_CONTROLLER
	bool "Cache controller driver support"
	default y if RISCV

if CACHE_CONTROLLER

config AX45MP_L2_CACHE
	bool "Andes Technology AX45MP L2 Cache controller"
	depends on RISCV
	depends on RISCV_SBI
	default y
	help
	  Support for the L2 cache controller on Andes Technology AX45MP
	  platforms.

config SIFIVE_CCACHE
	bool "Sifive Composable Cache controller"
	depends on RISCV
	default y
	help
	  Support for the composable cache controller on SiFive platforms.

endif
```
