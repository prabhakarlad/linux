// SPDX-License-Identifier: (GPL-2.0-only OR BSD-2-Clause)
/*
 * Device Tree Source for the RZ/Five SMARC EVK carrier board
 *
 * Copyright (C) 2022 Renesas Electronics Corp.
 */

#include <arm64/renesas/rzg2ul-smarc.dtsi>

&sdhi1 {
	status = "disabled";
};

&snd_rzg2l {
	status = "disabled";
};

&ssi1 {
	status = "disabled";
};

&vccq_sdhi1 {
	status = "disabled";
};
